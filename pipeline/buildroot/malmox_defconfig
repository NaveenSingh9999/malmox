## pipeline/buildroot/malmox_defconfig
```kconfig
# MalMox buildroot defconfig — i686, serial console ttyS0, ext4 rootfs
BR2_x86_pentium4=y
BR2_x86_generic=y
BR2_i386=y
BR2_KERNEL_HEADERS_6_1=y
BR2_LINUX_KERNEL=y
BR2_LINUX_KERNEL_CUSTOM_VERSION=y
BR2_LINUX_KERNEL_CUSTOM_VERSION_VALUE="6.6.32"
BR2_LINUX_KERNEL_USE_CUSTOM_CONFIG=y
BR2_LINUX_KERNEL_CUSTOM_CONFIG_FILE="/cfg/linux.config"
BR2_LINUX_KERNEL_ZIMAGE=y
BR2_TARGET_ROOTFS_EXT2=y
BR2_TARGET_ROOTFS_EXT2_4=y
BR2_TARGET_ROOTFS_EXT2_SIZE="48M"
BR2_PACKAGE_BUSYBOX_SHOW_OTHERS=y
BR2_PACKAGE_E2FSPROGS=y
# guest networking drivers (virtio + ne2k)
BR2_PACKAGE_LINUX_TOOLS=y
BR2_ROOTFS_DEVICE_CREATION_DYNAMIC_EUDEV=y
BR2_PACKAGE_DHCP=y
BR2_PACKAGE_DHCP_CLIENT=y
BR2_SYSTEM_DHCP="eth0"
BR2_PACKAGE_IPROUTE2=y
# autologin root on ttyS0
BR2_TARGET_GENERIC_GETTY=y
BR2_TARGET_GENERIC_GETTY_PORT="ttyS0"
BR2_TARGET_GENERIC_GETTY_BAUDRATE_115200=y
BR2_TARGET_GENERIC_GETTY_TERM="xterm-256color"
BR2_TARGET_GENERIC_ROOT_PASSWD=""
```
